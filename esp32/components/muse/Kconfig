## esp32/components/muse/Kconfig
```kconfig
# Copyright (c) Meta Platforms, Inc. and affiliates.
#
# Licensed under the Apache License, Version 2.0 (the "License");
# you may not use this file except in compliance with the License.
# You may obtain a copy of the License at
#
#     http://www.apache.org/licenses/LICENSE-2.0
#
# Unless required by applicable law or agreed to in writing, software
# distributed under the License is distributed on an "AS IS" BASIS,
# WITHOUT WARRANTIES OR CONDITIONS OF ANY KIND, either express or implied.
# See the License for the specific language governing permissions and
# limitations under the License.

menu "Muse"

    choice MUSE_BOARD
        prompt "Board with the full UI"
        default MUSE_BOARD_NONE
        help
            The UI is the voice companion on boards with a screen: an
            animated avatar, push-to-talk chat, settings, and battery
            handling. It runs beside Home Link, which owns Wi-Fi, BLE
            pairing, credentials and OTA. Pick the board it runs on, or none
            for a Link without a display.

        config MUSE_BOARD_NONE
            bool "None (Home Link without a display)"

        config MUSE_BOARD_WAVESHARE_S3_175C
            bool "Waveshare ESP32-S3-Touch-AMOLED-1.75C"
            depends on IDF_TARGET_ESP32S3

        config MUSE_BOARD_WAVESHARE_S3_175
            bool "Waveshare ESP32-S3-Touch-AMOLED-1.75 (not the 1.75C)"
            depends on IDF_TARGET_ESP32S3

        config MUSE_BOARD_AIPI
            bool "AIPI Lite (ESP32-S3, two buttons, no touch)"
            depends on IDF_TARGET_ESP32S3

        config MUSE_BOARD_ESPRESSIF_BOX_3
            bool "Espressif ESP32-S3-BOX-3 (320x240 touch LCD, speaker and microphones)"
            depends on IDF_TARGET_ESP32S3

        config MUSE_BOARD_WAVESHARE_C6_18
            bool "Waveshare ESP32-C6-Touch-AMOLED-1.8"
            depends on IDF_TARGET_ESP32C6

        config MUSE_BOARD_SENSECAP_WATCHER
            bool "Seeed SenseCAP Watcher (ESP32-S3, round touch LCD, wheel)"
            depends on IDF_TARGET_ESP32S3

        config MUSE_BOARD_M5STACK_CARDPUTER_ADV
            bool "M5Stack Cardputer ADV (ESP32-S3, keyboard, no PSRAM)"
            depends on IDF_TARGET_ESP32S3

        config MUSE_BOARD_M5STACK_STICKS3
            bool "M5Stack StickS3 (ESP32-S3, two buttons, no touch)"
            depends on IDF_TARGET_ESP32S3

        config MUSE_BOARD_M5STACK_STICKC_PLUS2
            bool "M5Stack StickC Plus2 (ESP32, two buttons, no touch)"
            depends on IDF_TARGET_ESP32

        config MUSE_BOARD_M5STACK_STOPWATCH
            bool "M5Stack StopWatch (ESP32-S3, round touch AMOLED)"
            depends on IDF_TARGET_ESP32S3

        config MUSE_BOARD_M5STACK_CORES3
            bool "M5Stack CoreS3 (ESP32-S3, 320x240 touch LCD, speaker and microphones)"
            depends on IDF_TARGET_ESP32S3

        config MUSE_BOARD_ESPRESSIF_VOCAT
            bool "Espressif ESP-VoCat / EchoEar (ESP32-S3, round 360 px touch LCD, speaker and microphones)"
            depends on IDF_TARGET_ESP32S3
    endchoice

    config MUSE_ENABLED
        bool
        default y if !MUSE_BOARD_NONE

    # Always defined, unlike the target-dependent board options, so
    # idf_component.yml rules can select each board's managed components.
    config MUSE_BOARD_ID
        string
        default "waveshare_s3_175c" if MUSE_BOARD_WAVESHARE_S3_175C
        default "waveshare_s3_175" if MUSE_BOARD_WAVESHARE_S3_175
        default "aipi" if MUSE_BOARD_AIPI
        default "espressif_box_3" if MUSE_BOARD_ESPRESSIF_BOX_3
        default "waveshare_c6_18" if MUSE_BOARD_WAVESHARE_C6_18
        default "sensecap_watcher" if MUSE_BOARD_SENSECAP_WATCHER
        default "m5stack_sticks3" if MUSE_BOARD_M5STACK_STICKS3
        default "m5stack_stickc_plus2" if MUSE_BOARD_M5STACK_STICKC_PLUS2
        default "m5stack_cardputer_adv" if MUSE_BOARD_M5STACK_CARDPUTER_ADV
        default "m5stack_stopwatch" if MUSE_BOARD_M5STACK_STOPWATCH
        default "m5stack_cores3" if MUSE_BOARD_M5STACK_CORES3
        default "espressif_vocat" if MUSE_BOARD_ESPRESSIF_VOCAT
        default "none"

    # The Muse tools' serial port: the console UART behind the board's USB
    # bridge, where the chip's own USB Serial/JTAG isn't wired to a connector
    # (the Watcher's USB-C goes to a CH342) or the chip has none.
    config MUSE_CONSOLE_UART
        bool
        default y if MUSE_BOARD_SENSECAP_WATCHER || !SOC_USB_SERIAL_JTAG_SUPPORTED

    # A board overlay can raise this for a quiet speaker.
    config MUSE_DEFAULT_VOLUME
        int "Speaker volume until one is chosen in settings (percent)"
        range 0 100
        default 70

    choice MUSE_VOCAT_REV
        prompt "ESP-VoCat board revision"
        depends on MUSE_BOARD_ESPRESSIF_VOCAT
        default MUSE_VOCAT_REV_AUTO
        help
            The revision is printed on the main board. v1.2 moved the
            microphone input, amplifier enable and panel reset pins and added
            a switch for the codecs' power. Detect at boot tells them apart by
            whether the speaker codec answers with that switch off.

        config MUSE_VOCAT_REV_AUTO
            bool "Detect at boot"

        config MUSE_VOCAT_REV_1_2
            bool "v1.2 (ESP32-S3-WROOM-1, 16 MB flash)"

        config MUSE_VOCAT_REV_1_0
            bool "v1.0 (ESP32-S3-WROOM-2, 32 MB flash)"
    endchoice

    config MUSE_VOCAT_HEAD_TALK
        bool "ESP-VoCat: touch the head to talk"
        depends on MUSE_BOARD_ESPRESSIF_VOCAT
        default y
        help
            Holding a hand on the touch strip on top of the head talks, as the
            BOOT button does. Turn it off if it triggers by itself.

    config MUSE_VOCAT_HEAD_THRESHOLD
        int "ESP-VoCat: head touch threshold (tenths of a percent)"
        depends on MUSE_VOCAT_HEAD_TALK
        range 3 200
        default 15
        help
            How far a touch pad's reading has to rise above its untouched
            level to count as a touch. Raise it if the head talks on its own;
            lower it if a hand on the head isn't noticed. 15 is 1.5%, the
            level Espressif's ESP-VoCat board support uses.

    config MUSE_WATCHER_CAMERA
        bool "SenseCAP Watcher camera capture and live preview"
        depends on MUSE_BOARD_SENSECAP_WATCHER && SPIRAM
        default n
        help
            Enable the camera.capture Home Link command and the wheel
            double-click camera preview. Camera buffers and tasks consume
            memory and preview decoding shares CPU time with voice and Link.
            Leave disabled to build without camera support.

    config MUSE_HATCH
        bool "Muse's own voice session"
        depends on MUSE_ENABLED
        default y if SPIRAM
        default n
        help
            Push-to-talk turns go over a voice session of Muse's own, to the
            VM Home Link is paired with or one set up on the device with a
            device token. Replies come as text, shown as captions, and are
            spoken with Volcengine's TTS when it has an API key (Speech,
            below). Needs PSRAM. Without it, voice notes go over Home Link's
            own session to its paired VM and replies are shown as text.

    menu "Speech (Volcengine TTS)"
        depends on MUSE_HATCH || HOMEHUB_VOICE

        config MUSE_TTS_API_KEY
            string "API key"
            default ""
            help
                A Volcengine API key (火山引擎 console, new-style API Key)
                with the resource below enabled. Empty: replies are shown,
                not spoken.

                Keep it out of git. Set it in your build directory's
                sdkconfig (idf.py -B <build dir> menuconfig), or in a
                devices/sdkconfig.local loaded after the board's overlay,
                which .gitignore keeps out of commits.

        config MUSE_TTS_RESOURCE_ID
            string "Resource ID"
            default "seed-tts-2.0"
            help
                X-Api-Resource-Id: seed-tts-2.0 for the 2.0 voices
                (*_uranus_bigtts), seed-tts-1.0 for 1.0 voices (*_moon_bigtts,
                *_mars_bigtts), seed-icl-2.0 for a cloned voice (S_...).

        config MUSE_TTS_SPEAKER
            string "Voice"
            default "zh_female_wenrouxiaoya_uranus_bigtts"
            help
                The voice (speaker) ID from Volcengine's voice list. The
                default is 温柔小雅 2.0; zh_female_vv_uranus_bigtts (Vivi 2.0)
                and zh_female_xiaohe_uranus_bigtts (小荷 2.0) are multilingual.
                It must match the resource ID.

        config MUSE_TTS_SPEECH_RATE
            int "Speech rate"
            range -50 100
            default 0
            help
                -50 is half speed, 0 normal, 100 double speed.

        config MUSE_TTS_STYLE
            string "Speaking instruction (2.0 voices)"
            default ""
            help
                Optional context_texts instruction for 2.0 voices, such as
                温柔地说话. Empty sends none.

    endmenu

endmenu
```
